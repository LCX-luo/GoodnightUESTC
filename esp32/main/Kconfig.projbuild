## esp32/main/Kconfig.projbuild
```kconfig
menu "Goodnight local configuration"
config GN_WIFI_SSID
    string "Wi-Fi SSID"
    default ""
config GN_WIFI_PASSWORD
    string "Wi-Fi password (local only)"
    default ""
config GN_MQTT_URI
    string "MQTT URI (mqtt:// or mqtts://)"
    default ""
config GN_TOPIC_PREFIX
    string "Topic prefix"
    default "goodnight"
config GN_DEVICE_ID
    string "Device identifier"
    default ""
config GN_ENCRYPTION_KEY
    string "AES-256 key: 64 hex characters (local only)"
    default ""
config GN_SIGNING_KEY
    string "HMAC-SHA256 key: 64 hex characters (local only)"
    default ""
endmenu
```

## esp32/sdkconfig.defaults
```kconfig
CONFIG_ESPTOOLPY_FLASHSIZE_4MB=y
CONFIG_PARTITION_TABLE_CUSTOM=y
CONFIG_PARTITION_TABLE_CUSTOM_FILENAME="partitions.csv"
CONFIG_COMPILER_CXX_EXCEPTIONS=y
# Native protocol uses AES-192 as well as AES-128/256.
# CONFIG_MBEDTLS_HARDWARE_AES is not set
CONFIG_MBEDTLS_CERTIFICATE_BUNDLE=y
CONFIG_MBEDTLS_DEFAULT_CERTIFICATE_BUNDLE=y
CONFIG_MQTT_TASK_STACK_SIZE=8192
```
